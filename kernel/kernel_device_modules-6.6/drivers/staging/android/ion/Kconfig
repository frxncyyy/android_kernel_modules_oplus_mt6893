## kernel/kernel_device_modules-6.6/drivers/staging/android/ion/Kconfig
```kconfig
# SPDX-License-Identifier: GPL-2.0
config ION
	tristate "ION Memory Allocator (ported from 4.19)"
	depends on DMA_SHARED_BUFFER
	help
	  ION is the memory allocator the vendor blobs on this device use.  It was
	  removed from mainline after 4.19 in favour of dma-buf heaps, but the
	  shipping userspace (vpud, libcodec2_vndk, libdpframework, libion_mtk)
	  speaks the ION ioctl ABI and only ever opens /dev/ion, so the 4.19 driver
	  is carried forward here.

config ION_SYSTEM_HEAP
	bool "ION system heap"
	depends on ION
	default y

config ION_CARVEOUT_HEAP
	bool "ION carveout heap"
	depends on ION
	default y

config ION_CHUNK_HEAP
	bool "ION chunk heap"
	depends on ION
	default y

config ION_CMA_HEAP
	bool "ION CMA heap"
	depends on ION
	default y

config MTK_ION_SEC_HEAP
	bool "MediaTek ION secure heap"
	depends on ION && MTK_TEE_GP_SUPPORT
	default n
```

## vendor/oplus/kernel/nfc/nfc_clkbuf/Kconfig
```kconfig
# SPDX-License-Identifier: GPL-2.0
config NFC_CLKBUF
	tristate "Force-enable MT6359P XO_NFC clock buffer for op6893"
	default n
	help
	  Small shim that binds the legacy DTB node "mediatek,pmic_clock_buffer"
	  and forces the MT6359P XO_NFC (EXTBUF3) clock buffer into SW mode with
	  EN_M=1, supplying the external 26 MHz reference the NXP SN100T NFC
	  controller needs.  Needed on the 6.6 GKI port because the in-tree
	  clkbuf driver only binds the new-schema "mediatek,mtXXXX-clkbuf" nodes.
	  Say M to build it as a loadable module.
```

## vendor/oplus/kernel/nfc/pn553/Kconfig
```kconfig
#
# NXP PN553/SN100 NCI (I2C) NFC driver for op6893
#

config NFC_PN553_DEVICES
	tristate "NXP pn553/SN100 NCI protocol (I2C) driver"
	default n
	help
	  NXP PN553/PN557/SN100 family NFC controller over I2C, exposing the
	  legacy /dev/nq-nci char device.  Ported from the mt6893 4.19 tree for
	  the 6.6 GKI port; binds the DTB's nxp,pn544 node (i2c8@0x28).  Say M
	  to build it as a loadable module.
```
